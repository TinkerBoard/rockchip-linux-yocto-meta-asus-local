## conf/layer.conf
```bitbake
# We have a conf and classes directory, add to BBPATH
BBPATH .= ":${LAYERDIR}"

# We have recipes-* directories, add to BBFILES
BBFILES += "${LAYERDIR}/recipes-*/*/*.bb \
            ${LAYERDIR}/recipes-*/*/*.bbappend"

BBFILE_COLLECTIONS += "asus-local"
BBFILE_PATTERN_asus-local = "^${LAYERDIR}/"
BBFILE_PRIORITY_asus-local = "9"

LAYERSERIES_COMPAT_asus-local = "honister"
```
